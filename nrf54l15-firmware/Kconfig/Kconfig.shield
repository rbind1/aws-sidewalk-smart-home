## nrf54l15-firmware/Kconfig/soc/Kconfig.sysbuild
```kconfig
# Load Sysbuild SoC Kconfig descriptions.
osource "C:/ncs/sidewalk-addon/zephyr/soc/xlnx/zynqmp/Kconfig.sysbuild"
osource "C:/ncs/sidewalk-addon/zephyr/soc/xlnx/zynq7000/Kconfig.sysbuild"
osource "C:/ncs/sidewalk-addon/zephyr/soc/xen/Kconfig.sysbuild"
osource "C:/ncs/sidewalk-addon/zephyr/soc/wch/ch32v00x/Kconfig.sysbuild"
osource "C:/ncs/sidewalk-addon/zephyr/soc/ti/simplelink/Kconfig.sysbuild"
osource "C:/ncs/sidewalk-addon/zephyr/soc/ti/lm3s6965/Kconfig.sysbuild"
osource "C:/ncs/sidewalk-addon/zephyr/soc/ti/k3/Kconfig.sysbuild"
osource "C:/ncs/sidewalk-addon/zephyr/soc/telink/tlsr/Kconfig.sysbuild"
osource "C:/ncs/sidewalk-addon/zephyr/soc/starfive/jh71xx/Kconfig.sysbuild"
osource "C:/ncs/sidewalk-addon/zephyr/soc/st/stm32/Kconfig.sysbuild"
osource "C:/ncs/sidewalk-addon/zephyr/soc/snps/qemu_arc/Kconfig.sysbuild"
osource "C:/ncs/sidewalk-addon/zephyr/soc/snps/nsim/arc_v/Kconfig.sysbuild"
osource "C:/ncs/sidewalk-addon/zephyr/soc/snps/nsim/arc_classic/Kconfig.sysbuild"
osource "C:/ncs/sidewalk-addon/zephyr/soc/snps/hsdk4xd/Kconfig.sysbuild"
osource "C:/ncs/sidewalk-addon/zephyr/soc/snps/hsdk/Kconfig.sysbuild"
osource "C:/ncs/sidewalk-addon/zephyr/soc/snps/emsk/Kconfig.sysbuild"
osource "C:/ncs/sidewalk-addon/zephyr/soc/snps/emsdp/Kconfig.sysbuild"
osource "C:/ncs/sidewalk-addon/zephyr/soc/snps/arc_iot/Kconfig.sysbuild"
osource "C:/ncs/sidewalk-addon/zephyr/soc/silabs/Kconfig.sysbuild"
osource "C:/ncs/sidewalk-addon/zephyr/soc/sifive/sifive_freedom/Kconfig.sysbuild"
osource "C:/ncs/sidewalk-addon/zephyr/soc/sensry/Kconfig.sysbuild"
osource "C:/ncs/sidewalk-addon/zephyr/soc/rockchip/Kconfig.sysbuild"
osource "C:/ncs/sidewalk-addon/zephyr/soc/renode/riscv_virtual/Kconfig.sysbuild"
osource "C:/ncs/sidewalk-addon/zephyr/soc/renode/cortex_r8_virtual/Kconfig.sysbuild"
osource "C:/ncs/sidewalk-addon/zephyr/soc/renesas/smartbond/Kconfig.sysbuild"
osource "C:/ncs/sidewalk-addon/zephyr/soc/renesas/rzt2m/Kconfig.sysbuild"
osource "C:/ncs/sidewalk-addon/zephyr/soc/renesas/rz/Kconfig.sysbuild"
osource "C:/ncs/sidewalk-addon/zephyr/soc/renesas/rcar/Kconfig.sysbuild"
osource "C:/ncs/sidewalk-addon/zephyr/soc/renesas/ra/Kconfig.sysbuild"
osource "C:/ncs/sidewalk-addon/zephyr/soc/realtek/ec/Kconfig.sysbuild"
osource "C:/ncs/sidewalk-addon/zephyr/soc/raspberrypi/rpi_pico/Kconfig.sysbuild"
osource "C:/ncs/sidewalk-addon/zephyr/soc/quicklogic/eos_s3/Kconfig.sysbuild"
osource "C:/ncs/sidewalk-addon/zephyr/soc/qemu/virt_riscv/Kconfig.sysbuild"
osource "C:/ncs/sidewalk-addon/zephyr/soc/qemu/malta/Kconfig.sysbuild"
osource "C:/ncs/sidewalk-addon/zephyr/soc/openisa/rv32m1/Kconfig.sysbuild"
osource "C:/ncs/sidewalk-addon/zephyr/soc/nxp/s32/Kconfig.sysbuild"
osource "C:/ncs/sidewalk-addon/zephyr/soc/nxp/rw/Kconfig.sysbuild"
osource "C:/ncs/sidewalk-addon/zephyr/soc/nxp/mcx/Kconfig.sysbuild"
osource "C:/ncs/sidewalk-addon/zephyr/soc/nxp/lpc/Kconfig.sysbuild"
osource "C:/ncs/sidewalk-addon/zephyr/soc/nxp/layerscape/Kconfig.sysbuild"
osource "C:/ncs/sidewalk-addon/zephyr/soc/nxp/kinetis/Kconfig.sysbuild"
osource "C:/ncs/sidewalk-addon/zephyr/soc/nxp/imxrt/Kconfig.sysbuild"
osource "C:/ncs/sidewalk-addon/zephyr/soc/nxp/imx/Kconfig.sysbuild"
osource "C:/ncs/sidewalk-addon/zephyr/soc/nuvoton/numicro/Kconfig.sysbuild"
osource "C:/ncs/sidewalk-addon/zephyr/soc/nuvoton/numaker/Kconfig.sysbuild"
osource "C:/ncs/sidewalk-addon/zephyr/soc/nuvoton/npcx/Kconfig.sysbuild"
osource "C:/ncs/sidewalk-addon/zephyr/soc/nuvoton/npcm/Kconfig.sysbuild"
osource "C:/ncs/sidewalk-addon/zephyr/soc/nordic/Kconfig.sysbuild"
osource "C:/ncs/sidewalk-addon/zephyr/soc/neorv32/Kconfig.sysbuild"
osource "C:/ncs/sidewalk-addon/zephyr/soc/native/inf_clock/Kconfig.sysbuild"
osource "C:/ncs/sidewalk-addon/zephyr/soc/microchip/miv/Kconfig.sysbuild"
osource "C:/ncs/sidewalk-addon/zephyr/soc/microchip/mec/Kconfig.sysbuild"
osource "C:/ncs/sidewalk-addon/zephyr/soc/mediatek/mt8xxx/Kconfig.sysbuild"
osource "C:/ncs/sidewalk-addon/zephyr/soc/lowrisc/opentitan/Kconfig.sysbuild"
osource "C:/ncs/sidewalk-addon/zephyr/soc/litex/litex_vexriscv/Kconfig.sysbuild"
osource "C:/ncs/sidewalk-addon/zephyr/soc/ite/ec/Kconfig.sysbuild"
osource "C:/ncs/sidewalk-addon/zephyr/soc/intel/raptor_lake/Kconfig.sysbuild"
osource "C:/ncs/sidewalk-addon/zephyr/soc/intel/lakemont/Kconfig.sysbuild"
osource "C:/ncs/sidewalk-addon/zephyr/soc/intel/intel_socfpga_std/Kconfig.sysbuild"
osource "C:/ncs/sidewalk-addon/zephyr/soc/intel/intel_socfpga/Kconfig.sysbuild"
osource "C:/ncs/sidewalk-addon/zephyr/soc/intel/intel_niosv/Kconfig.sysbuild"
osource "C:/ncs/sidewalk-addon/zephyr/soc/intel/intel_ish/Kconfig.sysbuild"
osource "C:/ncs/sidewalk-addon/zephyr/soc/intel/intel_adsp/Kconfig.sysbuild"
osource "C:/ncs/sidewalk-addon/zephyr/soc/intel/elkhart_lake/Kconfig.sysbuild"
osource "C:/ncs/sidewalk-addon/zephyr/soc/intel/atom/Kconfig.sysbuild"
osource "C:/ncs/sidewalk-addon/zephyr/soc/intel/apollo_lake/Kconfig.sysbuild"
osource "C:/ncs/sidewalk-addon/zephyr/soc/intel/alder_lake/Kconfig.sysbuild"
osource "C:/ncs/sidewalk-addon/zephyr/soc/infineon/cat3/Kconfig.sysbuild"
osource "C:/ncs/sidewalk-addon/zephyr/soc/infineon/cat1b/Kconfig.sysbuild"
osource "C:/ncs/sidewalk-addon/zephyr/soc/infineon/cat1a/Kconfig.sysbuild"
osource "C:/ncs/sidewalk-addon/zephyr/soc/gd/gd32/Kconfig.sysbuild"
osource "C:/ncs/sidewalk-addon/zephyr/soc/gaisler/leon3/Kconfig.sysbuild"
osource "C:/ncs/sidewalk-addon/zephyr/soc/gaisler/gr716a/Kconfig.sysbuild"
osource "C:/ncs/sidewalk-addon/zephyr/soc/espressif/Kconfig.sysbuild"
osource "C:/ncs/sidewalk-addon/zephyr/soc/ene/kb1200/Kconfig.sysbuild"
osource "C:/ncs/sidewalk-addon/zephyr/soc/efinix/sapphire/Kconfig.sysbuild"
osource "C:/ncs/sidewalk-addon/zephyr/soc/cdns/xtensa_sample_controller/Kconfig.sysbuild"
osource "C:/ncs/sidewalk-addon/zephyr/soc/cdns/sample_controller32/Kconfig.sysbuild"
osource "C:/ncs/sidewalk-addon/zephyr/soc/cdns/dc233c/Kconfig.sysbuild"
osource "C:/ncs/sidewalk-addon/zephyr/soc/brcm/bcmvk/Kconfig.sysbuild"
osource "C:/ncs/sidewalk-addon/zephyr/soc/brcm/bcm2712/Kconfig.sysbuild"
osource "C:/ncs/sidewalk-addon/zephyr/soc/brcm/bcm2711/Kconfig.sysbuild"
osource "C:/ncs/sidewalk-addon/zephyr/soc/atmel/sam0/Kconfig.sysbuild"
osource "C:/ncs/sidewalk-addon/zephyr/soc/atmel/sam/Kconfig.sysbuild"
osource "C:/ncs/sidewalk-addon/zephyr/soc/aspeed/Kconfig.sysbuild"
osource "C:/ncs/sidewalk-addon/zephyr/soc/arm/Kconfig.sysbuild"
osource "C:/ncs/sidewalk-addon/zephyr/soc/arm/beetle/Kconfig.sysbuild"
osource "C:/ncs/sidewalk-addon/zephyr/soc/andestech/Kconfig.sysbuild"
osource "C:/ncs/sidewalk-addon/zephyr/soc/amd/acp_6_0/Kconfig.sysbuild"
osource "C:/ncs/sidewalk-addon/zephyr/soc/ambiq/Kconfig.sysbuild"
osource "C:/ncs/sidewalk-addon/zephyr/soc/altr/zephyr_nios2f/Kconfig.sysbuild"
osource "C:/ncs/sidewalk-addon/zephyr/soc/altr/qemu_nios2/Kconfig.sysbuild"
osource "C:/ncs/sidewalk-addon/zephyr/soc/adi/max32/Kconfig.sysbuild"
osource "C:/ncs/sidewalk-addon/nrf/soc/nordic/Kconfig.sysbuild"
```

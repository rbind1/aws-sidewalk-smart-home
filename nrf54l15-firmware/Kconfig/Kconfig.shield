## nrf54l15-firmware/Kconfig/Kconfig.shield
```kconfig
osource "C:/ncs/sidewalk-addon/sidewalk/boards/shields/*/Kconfig.shield"
osource "C:/ncs/sidewalk-addon/nrf/boards/shields/*/Kconfig.shield"
```

## nrf54l15-firmware/Kconfig/Kconfig.shield.defconfig
```kconfig
osource "C:/ncs/sidewalk-addon/sidewalk/boards/shields/*/Kconfig.defconfig"
osource "C:/ncs/sidewalk-addon/nrf/boards/shields/*/Kconfig.defconfig"
```

## nrf54l15-firmware/Kconfig/arch/Kconfig
```kconfig
# Load Zephyr Arch Kconfig descriptions.
osource "C:/ncs/sidewalk-addon/zephyr/arch/x86/Kconfig"
osource "C:/ncs/sidewalk-addon/zephyr/arch/xtensa/Kconfig"
osource "C:/ncs/sidewalk-addon/zephyr/arch/sparc/Kconfig"
osource "C:/ncs/sidewalk-addon/zephyr/arch/riscv/Kconfig"
osource "C:/ncs/sidewalk-addon/zephyr/arch/posix/Kconfig"
osource "C:/ncs/sidewalk-addon/zephyr/arch/nios2/Kconfig"
osource "C:/ncs/sidewalk-addon/zephyr/arch/mips/Kconfig"
osource "C:/ncs/sidewalk-addon/zephyr/arch/arm64/Kconfig"
osource "C:/ncs/sidewalk-addon/zephyr/arch/arm/Kconfig"
osource "C:/ncs/sidewalk-addon/zephyr/arch/arc/Kconfig"
```

## nrf54l15-firmware/Kconfig/boards/Kconfig
```kconfig
# Load Zephyr board Kconfig descriptions.
osource "C:/ncs/sidewalk-addon/zephyr/boards/nordic/nrf54l15dk/Kconfig"
```

## nrf54l15-firmware/Kconfig/boards/Kconfig.defconfig
```kconfig
# Load Zephyr board defconfig descriptions.
osource "C:/ncs/sidewalk-addon/zephyr/boards/nordic/nrf54l15dk/Kconfig.defconfig"
```

## nrf54l15-firmware/Kconfig/boards/Kconfig.nrf54l15dk
```kconfig
# Load board Kconfig descriptions.
osource "C:/ncs/sidewalk-addon/zephyr/boards/nordic/nrf54l15dk/Kconfig.nrf54l15dk"
```

## nrf54l15-firmware/Kconfig/soc/Kconfig
```kconfig
# Load Zephyr SoC Kconfig descriptions.
osource "C:/ncs/sidewalk-addon/zephyr/soc/xlnx/zynqmp/Kconfig"
osource "C:/ncs/sidewalk-addon/zephyr/soc/xlnx/zynq7000/Kconfig"
osource "C:/ncs/sidewalk-addon/zephyr/soc/xen/Kconfig"
osource "C:/ncs/sidewalk-addon/zephyr/soc/wch/ch32v00x/Kconfig"
osource "C:/ncs/sidewalk-addon/zephyr/soc/ti/simplelink/Kconfig"
osource "C:/ncs/sidewalk-addon/zephyr/soc/ti/lm3s6965/Kconfig"
osource "C:/ncs/sidewalk-addon/zephyr/soc/ti/k3/Kconfig"
osource "C:/ncs/sidewalk-addon/zephyr/soc/telink/tlsr/Kconfig"
osource "C:/ncs/sidewalk-addon/zephyr/soc/starfive/jh71xx/Kconfig"
osource "C:/ncs/sidewalk-addon/zephyr/soc/st/stm32/Kconfig"
osource "C:/ncs/sidewalk-addon/zephyr/soc/snps/qemu_arc/Kconfig"
osource "C:/ncs/sidewalk-addon/zephyr/soc/snps/nsim/arc_v/Kconfig"
osource "C:/ncs/sidewalk-addon/zephyr/soc/snps/nsim/arc_classic/Kconfig"
osource "C:/ncs/sidewalk-addon/zephyr/soc/snps/hsdk4xd/Kconfig"
osource "C:/ncs/sidewalk-addon/zephyr/soc/snps/hsdk/Kconfig"
osource "C:/ncs/sidewalk-addon/zephyr/soc/snps/emsk/Kconfig"
osource "C:/ncs/sidewalk-addon/zephyr/soc/snps/emsdp/Kconfig"
osource "C:/ncs/sidewalk-addon/zephyr/soc/snps/arc_iot/Kconfig"
osource "C:/ncs/sidewalk-addon/zephyr/soc/silabs/Kconfig"
osource "C:/ncs/sidewalk-addon/zephyr/soc/sifive/sifive_freedom/Kconfig"
osource "C:/ncs/sidewalk-addon/zephyr/soc/sensry/Kconfig"
osource "C:/ncs/sidewalk-addon/zephyr/soc/rockchip/Kconfig"
osource "C:/ncs/sidewalk-addon/zephyr/soc/renode/riscv_virtual/Kconfig"
osource "C:/ncs/sidewalk-addon/zephyr/soc/renode/cortex_r8_virtual/Kconfig"
osource "C:/ncs/sidewalk-addon/zephyr/soc/renesas/smartbond/Kconfig"
osource "C:/ncs/sidewalk-addon/zephyr/soc/renesas/rzt2m/Kconfig"
osource "C:/ncs/sidewalk-addon/zephyr/soc/renesas/rz/Kconfig"
osource "C:/ncs/sidewalk-addon/zephyr/soc/renesas/rcar/Kconfig"
osource "C:/ncs/sidewalk-addon/zephyr/soc/renesas/ra/Kconfig"
osource "C:/ncs/sidewalk-addon/zephyr/soc/realtek/ec/Kconfig"
osource "C:/ncs/sidewalk-addon/zephyr/soc/raspberrypi/rpi_pico/Kconfig"
osource "C:/ncs/sidewalk-addon/zephyr/soc/quicklogic/eos_s3/Kconfig"
osource "C:/ncs/sidewalk-addon/zephyr/soc/qemu/virt_riscv/Kconfig"
osource "C:/ncs/sidewalk-addon/zephyr/soc/qemu/malta/Kconfig"
osource "C:/ncs/sidewalk-addon/zephyr/soc/openisa/rv32m1/Kconfig"
osource "C:/ncs/sidewalk-addon/zephyr/soc/nxp/s32/Kconfig"
osource "C:/ncs/sidewalk-addon/zephyr/soc/nxp/rw/Kconfig"
osource "C:/ncs/sidewalk-addon/zephyr/soc/nxp/mcx/Kconfig"
osource "C:/ncs/sidewalk-addon/zephyr/soc/nxp/lpc/Kconfig"
osource "C:/ncs/sidewalk-addon/zephyr/soc/nxp/layerscape/Kconfig"
osource "C:/ncs/sidewalk-addon/zephyr/soc/nxp/kinetis/Kconfig"
osource "C:/ncs/sidewalk-addon/zephyr/soc/nxp/imxrt/Kconfig"
osource "C:/ncs/sidewalk-addon/zephyr/soc/nxp/imx/Kconfig"
osource "C:/ncs/sidewalk-addon/zephyr/soc/nuvoton/numicro/Kconfig"
osource "C:/ncs/sidewalk-addon/zephyr/soc/nuvoton/numaker/Kconfig"
osource "C:/ncs/sidewalk-addon/zephyr/soc/nuvoton/npcx/Kconfig"
osource "C:/ncs/sidewalk-addon/zephyr/soc/nuvoton/npcm/Kconfig"
osource "C:/ncs/sidewalk-addon/zephyr/soc/nordic/Kconfig"
osource "C:/ncs/sidewalk-addon/zephyr/soc/neorv32/Kconfig"
osource "C:/ncs/sidewalk-addon/zephyr/soc/native/inf_clock/Kconfig"
osource "C:/ncs/sidewalk-addon/zephyr/soc/microchip/miv/Kconfig"
osource "C:/ncs/sidewalk-addon/zephyr/soc/microchip/mec/Kconfig"
osource "C:/ncs/sidewalk-addon/zephyr/soc/mediatek/mt8xxx/Kconfig"
osource "C:/ncs/sidewalk-addon/zephyr/soc/lowrisc/opentitan/Kconfig"
osource "C:/ncs/sidewalk-addon/zephyr/soc/litex/litex_vexriscv/Kconfig"
osource "C:/ncs/sidewalk-addon/zephyr/soc/ite/ec/Kconfig"
osource "C:/ncs/sidewalk-addon/zephyr/soc/intel/raptor_lake/Kconfig"
osource "C:/ncs/sidewalk-addon/zephyr/soc/intel/lakemont/Kconfig"
osource "C:/ncs/sidewalk-addon/zephyr/soc/intel/intel_socfpga_std/Kconfig"
osource "C:/ncs/sidewalk-addon/zephyr/soc/intel/intel_socfpga/Kconfig"
osource "C:/ncs/sidewalk-addon/zephyr/soc/intel/intel_niosv/Kconfig"
osource "C:/ncs/sidewalk-addon/zephyr/soc/intel/intel_ish/Kconfig"
osource "C:/ncs/sidewalk-addon/zephyr/soc/intel/intel_adsp/Kconfig"
osource "C:/ncs/sidewalk-addon/zephyr/soc/intel/elkhart_lake/Kconfig"
osource "C:/ncs/sidewalk-addon/zephyr/soc/intel/atom/Kconfig"
osource "C:/ncs/sidewalk-addon/zephyr/soc/intel/apollo_lake/Kconfig"
osource "C:/ncs/sidewalk-addon/zephyr/soc/intel/alder_lake/Kconfig"
osource "C:/ncs/sidewalk-addon/zephyr/soc/infineon/cat3/Kconfig"
osource "C:/ncs/sidewalk-addon/zephyr/soc/infineon/cat1b/Kconfig"
osource "C:/ncs/sidewalk-addon/zephyr/soc/infineon/cat1a/Kconfig"
osource "C:/ncs/sidewalk-addon/zephyr/soc/gd/gd32/Kconfig"
osource "C:/ncs/sidewalk-addon/zephyr/soc/gaisler/leon3/Kconfig"
osource "C:/ncs/sidewalk-addon/zephyr/soc/gaisler/gr716a/Kconfig"
osource "C:/ncs/sidewalk-addon/zephyr/soc/espressif/Kconfig"
osource "C:/ncs/sidewalk-addon/zephyr/soc/ene/kb1200/Kconfig"
osource "C:/ncs/sidewalk-addon/zephyr/soc/efinix/sapphire/Kconfig"
osource "C:/ncs/sidewalk-addon/zephyr/soc/cdns/xtensa_sample_controller/Kconfig"
osource "C:/ncs/sidewalk-addon/zephyr/soc/cdns/sample_controller32/Kconfig"
osource "C:/ncs/sidewalk-addon/zephyr/soc/cdns/dc233c/Kconfig"
osource "C:/ncs/sidewalk-addon/zephyr/soc/brcm/bcmvk/Kconfig"
osource "C:/ncs/sidewalk-addon/zephyr/soc/brcm/bcm2712/Kconfig"
osource "C:/ncs/sidewalk-addon/zephyr/soc/brcm/bcm2711/Kconfig"
osource "C:/ncs/sidewalk-addon/zephyr/soc/atmel/sam0/Kconfig"
osource "C:/ncs/sidewalk-addon/zephyr/soc/atmel/sam/Kconfig"
osource "C:/ncs/sidewalk-addon/zephyr/soc/aspeed/Kconfig"
osource "C:/ncs/sidewalk-addon/zephyr/soc/arm/Kconfig"
osource "C:/ncs/sidewalk-addon/zephyr/soc/arm/beetle/Kconfig"
osource "C:/ncs/sidewalk-addon/zephyr/soc/andestech/Kconfig"
osource "C:/ncs/sidewalk-addon/zephyr/soc/amd/acp_6_0/Kconfig"
osource "C:/ncs/sidewalk-addon/zephyr/soc/ambiq/Kconfig"
osource "C:/ncs/sidewalk-addon/zephyr/soc/altr/zephyr_nios2f/Kconfig"
osource "C:/ncs/sidewalk-addon/zephyr/soc/altr/qemu_nios2/Kconfig"
osource "C:/ncs/sidewalk-addon/zephyr/soc/adi/max32/Kconfig"
osource "C:/ncs/sidewalk-addon/nrf/soc/nordic/Kconfig"
```

## nrf54l15-firmware/Kconfig/soc/Kconfig.defconfig
```kconfig
# Load Zephyr SoC defconfig descriptions.
osource "C:/ncs/sidewalk-addon/zephyr/soc/xlnx/zynqmp/Kconfig.defconfig"
osource "C:/ncs/sidewalk-addon/zephyr/soc/xlnx/zynq7000/Kconfig.defconfig"
osource "C:/ncs/sidewalk-addon/zephyr/soc/xen/Kconfig.defconfig"
osource "C:/ncs/sidewalk-addon/zephyr/soc/wch/ch32v00x/Kconfig.defconfig"
osource "C:/ncs/sidewalk-addon/zephyr/soc/ti/simplelink/Kconfig.defconfig"
osource "C:/ncs/sidewalk-addon/zephyr/soc/ti/lm3s6965/Kconfig.defconfig"
osource "C:/ncs/sidewalk-addon/zephyr/soc/ti/k3/Kconfig.defconfig"
osource "C:/ncs/sidewalk-addon/zephyr/soc/telink/tlsr/Kconfig.defconfig"
osource "C:/ncs/sidewalk-addon/zephyr/soc/starfive/jh71xx/Kconfig.defconfig"
osource "C:/ncs/sidewalk-addon/zephyr/soc/st/stm32/Kconfig.defconfig"
osource "C:/ncs/sidewalk-addon/zephyr/soc/snps/qemu_arc/Kconfig.defconfig"
osource "C:/ncs/sidewalk-addon/zephyr/soc/snps/nsim/arc_v/Kconfig.defconfig"
osource "C:/ncs/sidewalk-addon/zephyr/soc/snps/nsim/arc_classic/Kconfig.defconfig"
osource "C:/ncs/sidewalk-addon/zephyr/soc/snps/hsdk4xd/Kconfig.defconfig"
osource "C:/ncs/sidewalk-addon/zephyr/soc/snps/hsdk/Kconfig.defconfig"
osource "C:/ncs/sidewalk-addon/zephyr/soc/snps/emsk/Kconfig.defconfig"
osource "C:/ncs/sidewalk-addon/zephyr/soc/snps/emsdp/Kconfig.defconfig"
osource "C:/ncs/sidewalk-addon/zephyr/soc/snps/arc_iot/Kconfig.defconfig"
osource "C:/ncs/sidewalk-addon/zephyr/soc/silabs/Kconfig.defconfig"
osource "C:/ncs/sidewalk-addon/zephyr/soc/sifive/sifive_freedom/Kconfig.defconfig"
osource "C:/ncs/sidewalk-addon/zephyr/soc/sensry/Kconfig.defconfig"
osource "C:/ncs/sidewalk-addon/zephyr/soc/rockchip/Kconfig.defconfig"
osource "C:/ncs/sidewalk-addon/zephyr/soc/renode/riscv_virtual/Kconfig.defconfig"
osource "C:/ncs/sidewalk-addon/zephyr/soc/renode/cortex_r8_virtual/Kconfig.defconfig"
osource "C:/ncs/sidewalk-addon/zephyr/soc/renesas/smartbond/Kconfig.defconfig"
osource "C:/ncs/sidewalk-addon/zephyr/soc/renesas/rzt2m/Kconfig.defconfig"
osource "C:/ncs/sidewalk-addon/zephyr/soc/renesas/rz/Kconfig.defconfig"
osource "C:/ncs/sidewalk-addon/zephyr/soc/renesas/rcar/Kconfig.defconfig"
osource "C:/ncs/sidewalk-addon/zephyr/soc/renesas/ra/Kconfig.defconfig"
osource "C:/ncs/sidewalk-addon/zephyr/soc/realtek/ec/Kconfig.defconfig"
osource "C:/ncs/sidewalk-addon/zephyr/soc/raspberrypi/rpi_pico/Kconfig.defconfig"
osource "C:/ncs/sidewalk-addon/zephyr/soc/quicklogic/eos_s3/Kconfig.defconfig"
osource "C:/ncs/sidewalk-addon/zephyr/soc/qemu/virt_riscv/Kconfig.defconfig"
osource "C:/ncs/sidewalk-addon/zephyr/soc/qemu/malta/Kconfig.defconfig"
osource "C:/ncs/sidewalk-addon/zephyr/soc/openisa/rv32m1/Kconfig.defconfig"
osource "C:/ncs/sidewalk-addon/zephyr/soc/nxp/s32/Kconfig.defconfig"
osource "C:/ncs/sidewalk-addon/zephyr/soc/nxp/rw/Kconfig.defconfig"
osource "C:/ncs/sidewalk-addon/zephyr/soc/nxp/mcx/Kconfig.defconfig"
osource "C:/ncs/sidewalk-addon/zephyr/soc/nxp/lpc/Kconfig.defconfig"
osource "C:/ncs/sidewalk-addon/zephyr/soc/nxp/layerscape/Kconfig.defconfig"
osource "C:/ncs/sidewalk-addon/zephyr/soc/nxp/kinetis/Kconfig.defconfig"
osource "C:/ncs/sidewalk-addon/zephyr/soc/nxp/imxrt/Kconfig.defconfig"
osource "C:/ncs/sidewalk-addon/zephyr/soc/nxp/imx/Kconfig.defconfig"
osource "C:/ncs/sidewalk-addon/zephyr/soc/nuvoton/numicro/Kconfig.defconfig"
osource "C:/ncs/sidewalk-addon/zephyr/soc/nuvoton/numaker/Kconfig.defconfig"
osource "C:/ncs/sidewalk-addon/zephyr/soc/nuvoton/npcx/Kconfig.defconfig"
osource "C:/ncs/sidewalk-addon/zephyr/soc/nuvoton/npcm/Kconfig.defconfig"
osource "C:/ncs/sidewalk-addon/zephyr/soc/nordic/Kconfig.defconfig"
osource "C:/ncs/sidewalk-addon/zephyr/soc/neorv32/Kconfig.defconfig"
osource "C:/ncs/sidewalk-addon/zephyr/soc/native/inf_clock/Kconfig.defconfig"
osource "C:/ncs/sidewalk-addon/zephyr/soc/microchip/miv/Kconfig.defconfig"
osource "C:/ncs/sidewalk-addon/zephyr/soc/microchip/mec/Kconfig.defconfig"
osource "C:/ncs/sidewalk-addon/zephyr/soc/mediatek/mt8xxx/Kconfig.defconfig"
osource "C:/ncs/sidewalk-addon/zephyr/soc/lowrisc/opentitan/Kconfig.defconfig"
osource "C:/ncs/sidewalk-addon/zephyr/soc/litex/litex_vexriscv/Kconfig.defconfig"
osource "C:/ncs/sidewalk-addon/zephyr/soc/ite/ec/Kconfig.defconfig"
osource "C:/ncs/sidewalk-addon/zephyr/soc/intel/raptor_lake/Kconfig.defconfig"
osource "C:/ncs/sidewalk-addon/zephyr/soc/intel/lakemont/Kconfig.defconfig"
osource "C:/ncs/sidewalk-addon/zephyr/soc/intel/intel_socfpga_std/Kconfig.defconfig"
osource "C:/ncs/sidewalk-addon/zephyr/soc/intel/intel_socfpga/Kconfig.defconfig"
osource "C:/ncs/sidewalk-addon/zephyr/soc/intel/intel_niosv/Kconfig.defconfig"
osource "C:/ncs/sidewalk-addon/zephyr/soc/intel/intel_ish/Kconfig.defconfig"
osource "C:/ncs/sidewalk-addon/zephyr/soc/intel/intel_adsp/Kconfig.defconfig"
osource "C:/ncs/sidewalk-addon/zephyr/soc/intel/elkhart_lake/Kconfig.defconfig"
osource "C:/ncs/sidewalk-addon/zephyr/soc/intel/atom/Kconfig.defconfig"
osource "C:/ncs/sidewalk-addon/zephyr/soc/intel/apollo_lake/Kconfig.defconfig"
osource "C:/ncs/sidewalk-addon/zephyr/soc/intel/alder_lake/Kconfig.defconfig"
osource "C:/ncs/sidewalk-addon/zephyr/soc/infineon/cat3/Kconfig.defconfig"
osource "C:/ncs/sidewalk-addon/zephyr/soc/infineon/cat1b/Kconfig.defconfig"
osource "C:/ncs/sidewalk-addon/zephyr/soc/infineon/cat1a/Kconfig.defconfig"
osource "C:/ncs/sidewalk-addon/zephyr/soc/gd/gd32/Kconfig.defconfig"
osource "C:/ncs/sidewalk-addon/zephyr/soc/gaisler/leon3/Kconfig.defconfig"
osource "C:/ncs/sidewalk-addon/zephyr/soc/gaisler/gr716a/Kconfig.defconfig"
osource "C:/ncs/sidewalk-addon/zephyr/soc/espressif/Kconfig.defconfig"
osource "C:/ncs/sidewalk-addon/zephyr/soc/ene/kb1200/Kconfig.defconfig"
osource "C:/ncs/sidewalk-addon/zephyr/soc/efinix/sapphire/Kconfig.defconfig"
osource "C:/ncs/sidewalk-addon/zephyr/soc/cdns/xtensa_sample_controller/Kconfig.defconfig"
osource "C:/ncs/sidewalk-addon/zephyr/soc/cdns/sample_controller32/Kconfig.defconfig"
osource "C:/ncs/sidewalk-addon/zephyr/soc/cdns/dc233c/Kconfig.defconfig"
osource "C:/ncs/sidewalk-addon/zephyr/soc/brcm/bcmvk/Kconfig.defconfig"
osource "C:/ncs/sidewalk-addon/zephyr/soc/brcm/bcm2712/Kconfig.defconfig"
osource "C:/ncs/sidewalk-addon/zephyr/soc/brcm/bcm2711/Kconfig.defconfig"
osource "C:/ncs/sidewalk-addon/zephyr/soc/atmel/sam0/Kconfig.defconfig"
osource "C:/ncs/sidewalk-addon/zephyr/soc/atmel/sam/Kconfig.defconfig"
osource "C:/ncs/sidewalk-addon/zephyr/soc/aspeed/Kconfig.defconfig"
osource "C:/ncs/sidewalk-addon/zephyr/soc/arm/Kconfig.defconfig"
osource "C:/ncs/sidewalk-addon/zephyr/soc/arm/beetle/Kconfig.defconfig"
osource "C:/ncs/sidewalk-addon/zephyr/soc/andestech/Kconfig.defconfig"
osource "C:/ncs/sidewalk-addon/zephyr/soc/amd/acp_6_0/Kconfig.defconfig"
osource "C:/ncs/sidewalk-addon/zephyr/soc/ambiq/Kconfig.defconfig"
osource "C:/ncs/sidewalk-addon/zephyr/soc/altr/zephyr_nios2f/Kconfig.defconfig"
osource "C:/ncs/sidewalk-addon/zephyr/soc/altr/qemu_nios2/Kconfig.defconfig"
osource "C:/ncs/sidewalk-addon/zephyr/soc/adi/max32/Kconfig.defconfig"
osource "C:/ncs/sidewalk-addon/nrf/soc/nordic/Kconfig.defconfig"
```
